## conf/machine/rzv2h-evk-ver1.conf
```bitbake
#@TYPE: Machine
#@NAME: rzv2h-evk-version1 machine
#@DESCRIPTION: RZ/V2H Evaluation Board Kit

SOC_FAMILY = "r9a09g057"
require conf/machine/include/arm/armv8-2a/tune-cortexa55.inc

MACHINE_FEATURES = " opengles opencl hwh264enc hwh264dec hwh265enc hwh265dec"

# Install all the kernel modules into the rootfs
MACHINE_EXTRA_RRECOMMENDS += "kernel-modules"

KERNEL_IMAGETYPE = "Image"
PREFERRED_PROVIDER_virtual/kernel ?= "linux-yocto"

IMAGE_FSTYPES ?= "wic wic.gz wic.bmap"
WKS_FILE ?= "genericarm64.wks.in"

EFI_PROVIDER ?= "${@bb.utils.contains("DISTRO_FEATURES", "systemd", "systemd-boot", "grub-efi", d)}"

# Try to bring up one physical serial console, or a virtualized serial console
SERIAL_CONSOLES ?= "115200;ttySC0"

# IPL
EXTRA_IMAGEDEPENDS += " flash-writer trusted-firmware-a firmware-pack"

WIC_INPUT_DEPENDS = "firmware-pack:do_deploy flash-writer:do_deploy"

# u-boot
UBOOT_CONFIG ??= "rzv2h-evk-ver1"
UBOOT_CONFIG[rzv2h-evk-ver1] = "rzv2h-evk-ver1_defconfig"
```
